## app/common/bench_clock/Kconfig
```kconfig
menu "Bench clock"

    config BENCH_CLOCK_GPIO
        int "Clock input GPIO"
        default 4
        range 0 56
        help
            Input for the reference clock from the RPi. All boards of a bench
            count the rising edges of the same clock, so their tick counts
            form a shared timebase.

    config BENCH_CLOCK_HZ
        int "Clock frequency, Hz"
        default 100000
        range 1000 1000000
        help
            Must match the frequency the RPi generates. Only used to convert
            ticks to microseconds in reports.

    config BENCH_CLOCK_GLITCH_NS
        int "Glitch filter, ns (0 = off)"
        default 1000
        range 0 10000
        help
            Pulses shorter than this are ignored. Keep it well below half the
            clock period (5000 ns at 100 kHz).

endmenu
```

## app/common/bench_wifi/Kconfig
```kconfig
menu "Bench Wi-Fi"

    config BENCH_WIFI_SSID
        string "Wi-Fi SSID"
        default "Bench_AP"

    config BENCH_WIFI_PASSWORD
        string "Wi-Fi password"
        default "zxcqwe11"

endmenu
```

## app/esp32_modbus_bench/main/Kconfig.projbuild
```kconfig
menu "Modbus bench"

    config BENCH_MB_PORT
        int "Modbus TCP port"
        default 502
        range 1 65535
        help
            Wireshark decodes Modbus/TCP on 502 only; other ports need Decode As.

    config BENCH_MB_UID
        int "Unit identifier"
        default 1
        range 1 247

    config BENCH_DATA_REGS
        int "Holding registers with payload data"
        default 1000
        range 125 10000
        help
            Clients read payload from holding registers 0..N-1 (FC03).

endmenu
```

## app/esp32_mqtt_bench/main/Kconfig.projbuild
```kconfig
menu "MQTT bench"

    choice BENCH_ROLE
        prompt "Board role"
        default BENCH_ROLE_PUB
        help
            Set by the CMake preset (sdkconfig.defaults.pub / sdkconfig.defaults.sub).

        config BENCH_ROLE_PUB
            bool "Publisher: sends bench/data"

        config BENCH_ROLE_SUB
            bool "Subscriber: receives bench/data"
    endchoice

    config BENCH_BROKER_URI
        string "Broker URI"
        default "mqtt://192.168.4.1:1883"
        help
            Plain TCP (mqtt://), so Wireshark can dissect the traffic.

    config BENCH_MQTT_BUF_SIZE
        int "esp-mqtt in/out buffer size, bytes"
        default 4096
        range 1024 65536
        help
            Larger publishes are written to the socket in several chunks;
            larger incoming messages reach the subscriber in several events.

    config BENCH_MAX_PAYLOAD
        int "Max payload size accepted in a command, bytes"
        default 65536
        range 33 1048576

    config BENCH_MAX_INFLIGHT
        int "Max in-flight window accepted in a command (publisher)"
        default 64
        range 1 256

    config BENCH_SUB_QOS
        int "Subscription QoS for bench/data (subscriber)"
        default 2
        range 0 2
        help
            The broker delivers with min(publish QoS, subscription QoS), so 2
            makes the subscriber receive with whatever QoS the publisher uses.

    config BENCH_SUB_LOG_MAX
        int "Per-message log capacity, records (subscriber)"
        default 10000
        range 0 1000000
        help
            12 bytes per record (seq, tx_tick, rx_tick), allocated per run,
            PSRAM first if the board has it. 0 disables the log; the summary
            in bench/status is still sent.

    config BENCH_SUB_IDLE_MS
        int "End the run after this long without data, ms (subscriber)"
        default 3000
        range 100 600000

endmenu
```
